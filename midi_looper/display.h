#ifndef DISPLAY_H_GUARD
#define DISPLAY_H_GUARD


#include <SPI.h>
#include <Wire.h>
#include <Adafruit_GFX.h>
#include <Adafruit_SSD1306.h>

#include "debug.h"
#include "looper.h"


#define DISPLAY_ADDR 0x3C
#define LOGO_DURATION 2000


// 'ES_Logo_2016_2', 127x64px
const unsigned char enter_shikari_logo [] PROGMEM = {
	0xff, 0xff, 0xff, 0xff, 0xff, 0xff, 0xff, 0xe0, 0x07, 0xff, 0xff, 0xff, 0xff, 0xff, 0xff, 0xfe, 
	0xff, 0xff, 0xff, 0xff, 0xff, 0xff, 0xfe, 0x00, 0x00, 0x7f, 0xff, 0xff, 0xff, 0xff, 0xff, 0xfe, 
	0xff, 0xff, 0xff, 0xff, 0xff, 0xff, 0xf0, 0x00, 0x00, 0x0f, 0xff, 0xff, 0xff, 0xff, 0xff, 0xfe, 
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	0xff, 0xff, 0xff, 0xff, 0xff, 0xff, 0xff, 0xe0, 0x07, 0xff, 0xff, 0xff, 0xff, 0xff, 0xff, 0xfe
};




struct StationState{
    uint8_t total_loop;
    uint8_t current_loop;
    LoopStatus loop_status;
};




class Display{

    private:
        Adafruit_SSD1306 display;   //The low-level display interface

        Looper *loop_interface;

        StationState previousState;

        bool compareStates(StationState *state1, StationState *state2){
            if(state1->current_loop == state2->current_loop){
                if(state1->loop_status == state2->loop_status){
                    if(state1->total_loop == state2->total_loop){
                        return true;
                    }
                }
            }
            return false;
        }



    public:
        Display(Looper *looper){
            this->display = Adafruit_SSD1306(128, 64, &Wire);
            loop_interface = looper;

            previousState.total_loop = this->loop_interface->getTotalLoop();
            previousState.current_loop = this->loop_interface->getCurrentLoop();
        }

        void initialize(){
            debug("Initializing Display");
            this->display.begin(SSD1306_SWITCHCAPVCC, 0x3C); // Address 0x3C for 128x32
        }

        void clear(){
            this->display.clearDisplay();
            this->display.display();
        }

        void showLogo(){
            debug("Showing logo");
            this->display.drawBitmap(0, 0, enter_shikari_logo, 128, 64, SSD1306_WHITE);
            this->display.display();
            delay(LOGO_DURATION);
            this->display.clearDisplay();
            this->display.display();
        }


        void printText(char *text){
            display.setTextSize(2);                  // setTextSize applique est facteur d'échelle qui permet d'agrandir ou réduire la font
            display.setTextColor(WHITE);             // La couleur du texte
            display.setCursor(0,0);                  // On va écrire en x=0, y=0
            display.println("Hello, world!");        // un println comme pour écrire sur le port série
            display.setTextColor(BLACK, WHITE);      // On inverse les couleurs, le fond devient noir
            display.display();
            delay(1500);
            display.println("Hello, world!");        // Vous pouvez changer à la volée de Font (pour cela vous devez la déclarer comme une librairie en début de projet, par exemple #include <Fonts/FreeMono9pt7b.h>)
            //display.setFont(&FreeMono9pt7b);
            display.setTextColor(WHITE);
            display.println("Hello, world!");
            //display.setFont();                      // Pour revenir à la Font par défaut
        }


        void printLooperStatus(bool ignorePreviousState = false){
            
            StationState currentStatus;

            currentStatus.total_loop = this->loop_interface->getTotalLoop();
            currentStatus.current_loop = this->loop_interface->getCurrentLoop();
            currentStatus.loop_status = this->loop_interface->getLoopStatus();
             


            if(compareStates(&currentStatus, &previousState) && !ignorePreviousState){
                return;
            }

            previousState = currentStatus;



            String str_total_loop_desc = String("Total Loop: ");
            String total_loop = String(currentStatus.total_loop);
            
            String str_current_loop = String("Current Loop: ");
            String current_loop = String(currentStatus.current_loop, DEC);
            
            String str_status_desc = String("Status: ");
            String str_status;

            switch (currentStatus.loop_status){

            case empty:
                str_status = String("Empty");
                break;
            case recording:
                str_status = String("Recoring");
                break;
            case overdubbing:
                str_status = String("Overdubbing");
                break;
            case playing:
                str_status = String("Playing");
                break;
            case mute:
                str_status = String("Muted");
                break;                
            default:
                str_status = String("unimplemented");
                break;
            }


            this->clear();

            display.setTextSize(1);
            display.setTextColor(WHITE);
            display.setCursor(0,0);
            display.println(str_total_loop_desc + total_loop);
            display.println(str_current_loop);
            display.setTextSize(2);
            display.println(current_loop);
            display.setTextSize(1);            
            display.println(str_status_desc);
            display.setTextSize(2);
            display.println(str_status);
            display.setTextColor(BLACK, WHITE);
            display.display();
        }


};











#endif
